## src/board/supported/elecrow/Kconfig.elecrow
```kconfig
config BOARD_ELECROW_CROWPANEL_5_0
    bool "ELECROW_CROWPANEL_5_0"
    help
        https://www.elecrow.com/crowpanel-advance-5-0-hmi-esp32-ai-display-800x480-ips-artificial-intelligent-touch-screen.html

config BOARD_ELECROW_CROWPANEL_7_0
    bool "ELECROW_CROWPANEL_7_0"
    help
        https://www.elecrow.com/esp32-display-7-inch-hmi-display-rgb-tft-lcd-touch-screen-support-lvgl.html
```
